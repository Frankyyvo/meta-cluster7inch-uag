## conf/bblayers.conf
```bitbake
# POKY_BBLAYERS_CONF_VERSION is increased each time build/conf/bblayers.conf
# changes incompatibly
POKY_BBLAYERS_CONF_VERSION = "2"

BBPATH = "${TOPDIR}"
BBFILES ?= ""

BBLAYERS ?= " \
  /home/franky/Documents/yocto-cluster-automotriz/poky/meta \
  /home/franky/Documents/yocto-cluster-automotriz/poky/meta-poky \
  /home/franky/Documents/yocto-cluster-automotriz/poky/meta-yocto-bsp \
  /home/franky/Documents/yocto-cluster-automotriz/meta-cluster7inch-uag \
  "
```
